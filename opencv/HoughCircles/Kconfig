## opencv/HoughCircles/Kconfig
```kconfig
config SAMPLES_OPENCV_HOUGHCIRCLES
  bool "HoughCircles"
  default n
  select BOSP_SAMPLES_OPENCV
  ---help---
  Build the HoughCircles application.
  
  Insert here a description of this application.

  If unsure, say No to this option.
```

## opencv/Kconfig
```kconfig
source samples/opencv/background_learning/Kconfig
source samples/opencv/facedetect/Kconfig
source samples/opencv/HoughCircles/Kconfig
```
